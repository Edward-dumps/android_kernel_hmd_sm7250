## drivers/staging/uartctrl/Kconfig
```kconfig
config PRINTK_HMD_PREFIX
	bool "Prefix cpu_id/status/pid/process_name to each kernel log"
	default y
	help
	  PRINTK_HMD_PREFIX which is used to control whether to show
	  process information about this log.
	  the information about which cpu about this
	  process in, and whether in isr.

config HMD_PRINTK_UART_CONSOLE
	bool "HMD printk UART controller"
	default y
	help
	  HMD_PRINTK_UART_CONSOLE which is used to control whether to
	  control printk to uart console.  when boot up finish
	  uart console do not output printk log.
	  also RD can set the setting by command.
```
